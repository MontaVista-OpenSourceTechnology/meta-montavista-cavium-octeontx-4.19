## conf/layer.conf
```bitbake
# We have a conf and classes directory, add to BBPATH
BBPATH := "${BBPATH}:${LAYERDIR}"

# We have an images and various recipe-* directories, add to BBFILES
BBFILES := "${BBFILES} ${LAYERDIR}/recipes*/*/*.bb*"
	
BBFILE_COLLECTIONS += "cgx-msd-cavium-octeontx"
BBFILE_PATTERN_cgx-msd-cavium-octeontx := "^${LAYERDIR}/"
BBFILE_PRIORITY_cgx-msd-cavium-octeontx = "7"

LAYERDEPENDS = "core"

LAYERSERIES_COMPAT_cgx-msd-cavium-octeontx = "thud"

PREFERRED_VERSION_linux-mvista_cavium-octeontx ?= "4.19%"
```

## conf/machine/cavium-octeontx.conf
```bitbake
#@TYPE : Machine
#@NAME : Cavium ThunderX
#@Description : Machine configuration for running a Cavium ThunderX Little Endian ARM64
require conf/machine/include/qemu.inc
require include/cavium-octeontx.inc
DEFAULTTUNE = "thunderx"
KERNEL_IMAGETYPE = "Image"

KERNEL_DEVICETREE = " \
		cavium/thunder-88xx.dtb \
		"	
SERIAL_CONSOLE = "115200 ttyAMA0"

#For runqemu
QB_SYSTEM_NAME = "qemu-system-aarch64"
QB_MEM = "-m 512"
QB_MACHINE = "-machine virt"
QB_CPU = "-cpu cortex-a57"
QB_DEFAULT_KERNEL = "${KERNEL_IMAGETYPE}-cavium-octeontx.bin"
QB_KERNEL_CMDLINE_APPEND = "console=ttyAMA0,38400"
# Add the 'virtio-rng-pci' device otherwise the guest may run out of entropy
QB_OPT_APPEND = "-show-cursor -device virtio-rng-pci -monitor null"
QB_TAP_OPT = "-netdev tap,id=net0,ifname=@TAP@,script=no,downscript=no"
QB_NETWORK_DEVICE = "-device virtio-net-device,netdev=net0,mac=@MAC@"
QB_ROOTFS_OPT = "-drive id=disk0,file=@ROOTFS@,if=none,format=raw -device virtio-blk-device,drive=disk0"
QB_SERIAL_OPT = "-device virtio-serial-device -chardev null,id=virtcon -device virtconsole,chardev=virtcon"
QB_TCPSERIAL_OPT = " -device virtio-serial-device -chardev socket,id=virtcon,port=@PORT@,host=127.0.0.1 -device virtconsole,chardev=virtcon"
IMAGE_FSTYPES_append = " ext2 "

PREFERRED_PROVIDER_virtual/kernel = "linux-mvista"
```

## conf/machine/include/cavium-octeontx.inc
```bitbake
# Cavium ThunderX defaults

require conf/machine/include/soc-family.inc
require conf/machine/include/tune-thunderx.inc
include conf/machine/include/arm/arch-multilib-ilp32.inc

SOC_FAMILY = "cavium-octeontx"

# used by sysvinit_2

SERIAL_CONSOLE ?= "115200 ttyAMA0"
```
